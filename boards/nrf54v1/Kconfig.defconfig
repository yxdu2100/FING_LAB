## boards/nrf54v1/Kconfig.defconfig
```kconfig
config HW_STACK_PROTECTION
	default ARCH_HAS_STACK_PROTECTION

if BOARD_NRF54V1_NRF54L15_CPUAPP

config BT_CTLR
	default BT

config ROM_START_OFFSET
	default 0 if PARTITION_MANAGER_ENABLED
	default 0x800 if BOOTLOADER_MCUBOOT

endif # BOARD_NRF54V1_NRF54L15_CPUAPP
```

## boards/nrf54v1/Kconfig.nrf54v1
```kconfig
config BOARD_NRF54V1
	select SOC_NRF54L15_CPUAPP if BOARD_NRF54V1_NRF54L15_CPUAPP
	select SOC_NRF54L15_CPUFLPR if \
		BOARD_NRF54V1_NRF54L15_CPUFLPR || \
		BOARD_NRF54V1_NRF54L15_CPUFLPR_XIP
```

## boards/nrf54v1/board.yml
```yaml
board:
  name: nrf54v1
  vendor: nrf54l15
  socs:
  - name: nrf54l15
    variants:
    - name: xip
      cpucluster: cpuflpr
```
