## CMakeLists.txt
```
cmake_minimum_required(VERSION 3.20.0)
# Keep Zephyr's generated compiler-capability cache inside the selected build
# directory. This also makes command-line builds independent of host cache access.
set(USER_CACHE_DIR "${CMAKE_BINARY_DIR}/.cache" CACHE PATH "Zephyr user cache")
list(APPEND BOARD_ROOT ${CMAKE_CURRENT_SOURCE_DIR}/..)
find_package(Zephyr REQUIRED HINTS $ENV{ZEPHYR_BASE})

project(fing_lab_capture)

target_sources(app PRIVATE
    src/main.c
    src/ble/ble.c
    src/modes/mode_manager.c
    src/modules/camera/camera.c
    src/modules/imu/imu.c
    src/modules/imu/imu_stream.c
    src/modules/tof/tof.c
)

target_include_directories(app PRIVATE
    src
    src/ble
    src/modes
    src/modules/camera
    src/modules/imu
    src/modules/tof
)
```

## Kconfig
```
mainmenu "Fing Lab firmware"

source "Kconfig.zephyr"

config FING_BOARD_ID
	string "Stable Fing Lab board identifier"
	help
	  Stable identifier stored with every capture and IMU session. Keep this
	  value unchanged for the lifetime of the physical ring.

config FING_RING_SIZE_MM
	int "Ring size in millimetres"
	range 1 255

config FING_FIRMWARE_VERSION
	string "Fing Lab firmware version"
	default "0.5.0"
```

## prj.conf
```kconfig
# Logging over RTT
CONFIG_LOG=y
CONFIG_LOG_DEFAULT_LEVEL=3
CONFIG_CONSOLE=y
CONFIG_USE_SEGGER_RTT=y
CONFIG_RTT_CONSOLE=y
CONFIG_LOG_BACKEND_RTT=y
CONFIG_SEGGER_RTT_BUFFER_SIZE_UP=8192
CONFIG_SEGGER_RTT_BUFFER_SIZE_DOWN=512

# Sensors and camera interfaces
CONFIG_SENSOR=y
CONFIG_I2C=y
CONFIG_GPIO=y
CONFIG_VL53L1X_INTERRUPT_MODE=n
CONFIG_VL53L1X_XSHUT=y
CONFIG_NFCT_PINS_AS_GPIOS=y
CONFIG_SPI=y
CONFIG_SPI_SLAVE=y
CONFIG_SPI_ASYNC=y
CONFIG_NRFX_SPIS00=y
CONFIG_POLL=y
CONFIG_PM_DEVICE=y
CONFIG_CRC=y
CONFIG_NRFX_GPPI=y
CONFIG_NRFX_TIMER22=y
# Keeps the system in constant-latency mode (requested in main.c) so the CPU
# reliably wakes from idle; see the comment there.
CONFIG_NRF_SYS_EVENT=y
# Bluetooth image transport
CONFIG_BT=y
CONFIG_BT_PERIPHERAL=y
CONFIG_BT_LL_SOFTDEVICE=y
CONFIG_BT_MAX_CONN=1
CONFIG_BT_USER_PHY_UPDATE=y
CONFIG_BT_CTLR_DATA_LENGTH_MAX=251
CONFIG_BT_BUF_ACL_TX_SIZE=251
CONFIG_BT_BUF_ACL_RX_SIZE=251
CONFIG_BT_L2CAP_TX_MTU=247
CONFIG_BT_L2CAP_TX_BUF_COUNT=20
CONFIG_BT_CONN_TX_MAX=20

# Keep console traffic off the board UART.
CONFIG_SERIAL=y
CONFIG_UART_CONSOLE=n
CONFIG_UART_INTERRUPT_DRIVEN=n
```

## src/main.c
```c
#include <zephyr/logging/log.h>
#include "ble/ble.h"
#include "modes/mode_manager.h"
#include <zephyr/toolchain.h>
#include <nrf_sys_event.h>

BUILD_ASSERT(sizeof(CONFIG_FING_BOARD_ID) > 1,
             "No ring profile selected. Build with "
             "-DEXTRA_CONF_FILE=configs/fing_NNmm.conf");
BUILD_ASSERT(CONFIG_FING_RING_SIZE_MM > 0,
             "No ring profile selected. Build with "
             "-DEXTRA_CONF_FILE=configs/fing_NNmm.conf");

LOG_MODULE_REGISTER(main, LOG_LEVEL_INF);

int main(void)
{
    LOG_INF("Starting Fing Lab multi-mode study firmware");

    /* In low-power sleep the CPU was observed stuck in WFI with the GRTC
     * system-timer IRQ pending, freezing the kernel and BLE host until a
     * debugger halt woke it. Constant-latency mode keeps the wake-up path
     * powered so the CPU always leaves WFI, at the cost of some idle current. */
    int err = nrf_sys_event_request_global_constlat();
    if (err < 0) {
        LOG_ERR("Could not request constant-latency mode: %d", err);
    }

    err = mode_manager_init();
    if (err != 0) {
        LOG_ERR("Mode manager initialization failed: %d", err);
        return err;
    }

    err = ble_init(mode_manager_request, mode_manager_request_resend,
                   mode_manager_acknowledge_frame,
                   mode_manager_request_camera_recovery);
    if (err != 0) {
        LOG_ERR("BLE initialization failed: %d", err);
        return err;
    }

    /* Every ring boots in the common low-power IDLE state. The selected app
     * explicitly enters CAPTURE or STREAM after all matching notification
     * channels have been subscribed. */
    LOG_INF("Ready in IDLE: board=%s ring=%d mm firmware=%s",
            CONFIG_FING_BOARD_ID, CONFIG_FING_RING_SIZE_MM,
            CONFIG_FING_FIRMWARE_VERSION);
    mode_manager_run();
    return 0;
}
```

## src/app_config.h
```c
#ifndef APP_CONFIG_H
#define APP_CONFIG_H

#define TOF_MIN_DISTANCE_MM 60U
#define TOF_MAX_DISTANCE_MM 500U
#define CAMERA_CAPTURE_MAX_ATTEMPTS 5
/* Frames captured and thrown away before the kept frame, so auto-exposure can
 * settle. Each one costs a full frame period (~224 ms), so this is the largest
 * single contributor to gesture-to-photo latency.
 *
 * CAPTURE keeps the sensor streaming while it waits for a gesture, so AE has
 * already converged by the time a capture starts: an RTT burst log showed
 * integration=7 rows, again=0x00, dgain=0x114 identical across all four frames.
 * One discard is kept to absorb the scene change as the hand settles. */
#define CAMERA_AE_DISCARD_FRAMES 1U

/* HM01B0 image-quality tuning.
 *
 * The current sensor timing is 800 pixel clocks per row at a 1 MHz video
 * timing clock, or approximately 0.8 ms per integration row.  Therefore
 * 30 rows limits motion-producing exposure to approximately 24 ms.  When
 * changing the line timing in hm01b0_init.h, recalculate these row values.
 *
 * Analog gain codes are power-of-two limits: 0=1x, 1=2x, 2=4x, 3=8x.
 * Digital gain uses 2.6 fixed point: 0x40=1x, 0x80=2x, 0xC0=3x.
 */
#define CAMERA_AE_TARGET_MEAN              0x40U
#define CAMERA_LINE_LENGTH_PCK             800U
#define CAMERA_FRAME_LENGTH_LINES          280U
#define CAMERA_AE_MAX_INTEGRATION_ROWS     30U
#define CAMERA_AE_MIN_INTEGRATION_ROWS     2U
#define CAMERA_AE_MAX_ANALOG_GAIN_CODE     0x03U
#define CAMERA_AE_MAX_DIGITAL_GAIN_CODE    0x60U
#define CAMERA_AE_DAMPING_FACTOR           0x20U

/* Indoor-light flicker avoidance for the present 800 us row time. */
#define CAMERA_AE_FLICKER_AVOIDANCE        1
#define CAMERA_MAINS_FREQUENCY_HZ          60U
#define CAMERA_AE_60HZ_STEP_ROWS           10U
#define CAMERA_AE_50HZ_STEP_ROWS           13U

#if CAMERA_AE_MAX_INTEGRATION_ROWS > (CAMERA_FRAME_LENGTH_LINES - 2U)
#error "CAMERA_AE_MAX_INTEGRATION_ROWS must not exceed frame_length_lines - 2"
#endif

#if CAMERA_AE_MIN_INTEGRATION_ROWS > 255U
#error "CAMERA_AE_MIN_INTEGRATION_ROWS must fit in the HM01B0 8-bit register"
#endif

#if CAMERA_AE_MIN_INTEGRATION_ROWS > CAMERA_AE_MAX_INTEGRATION_ROWS
#error "CAMERA_AE_MIN_INTEGRATION_ROWS must not exceed the maximum"
#endif

#if CAMERA_AE_FLICKER_AVOIDANCE
#if CAMERA_MAINS_FREQUENCY_HZ == 60U
#define CAMERA_AE_FLICKER_CONTROL          0x03U
#elif CAMERA_MAINS_FREQUENCY_HZ == 50U
#define CAMERA_AE_FLICKER_CONTROL          0x01U
#else
#error "CAMERA_MAINS_FREQUENCY_HZ must be 50 or 60"
#endif
#else
#define CAMERA_AE_FLICKER_CONTROL          0x00U
#endif

/* Capture gesture configuration.
 *
 * Both implementations remain compiled into the firmware. Change only
 * CAPTURE_GESTURE_SOURCE to switch between the original MEMS Studio MLC
 * interrupt and the host-side rolling-window hover detector.
 */
#define CAPTURE_GESTURE_SOURCE_MLC        0U
#define CAPTURE_GESTURE_SOURCE_THRESHOLD  1U
#define CAPTURE_GESTURE_SOURCE CAPTURE_GESTURE_SOURCE_THRESHOLD

/* Original MLC path. Replace modules/imu/mlc.h when exporting a classifier,
 * then select the MLC source above and set its target class here. */
#define CAPTURE_MLC_TARGET_CLASS 0x00U

/* Threshold hover path. A 50-sample window (about 417 ms at 120 Hz) counts as
 * hover only when every sample satisfies all of the following:
 *   Y BAND  max(Y) <= 0.188720 g and min(Y) > -0.444580 g, from the original
 *           MEMS Studio decision tree (converted at 4096 LSB/g)
 *   FLAT    Z inside [-1.30 g, -0.70 g]: PCB face-down, gravity on -Z
 *   LEVEL   sqrt(X^2 + Y^2) <= 0.60 g, about 37 degrees of tilt
 *   STILL   max(Z) - min(Z) <= 0.12 g: the ring is held, not moving
 * Capture mode runs the accelerometer at +/-8 g. The FLAT, LEVEL and STILL
 * limits use the datasheet sensitivity of 0.244 mg/LSB, the same factor the
 * recording app used when it wrote mems_hover_dataset.
 *
 * Tuned on mems_hover_dataset (144 hover windows from 3 sessions, 288 null
 * windows), testing every window: the Y band alone detected 140/144 hover
 * windows and fired on 56/288 null windows. The combined rule detects 138/144
 * and fires on 51/288 at the 30-sample window used here. Detection was
 * unchanged for tilt 600-700 mg, stillness 120-140 mg and Z max -750..-650 mg,
 * so no limit sits on an edge.
 *
 * The window length sets the reaction time: every sample in it must match, so
 * the trigger comes one window after the hand stops moving. 30 samples is
 * about 265 ms at the ~113 Hz this loop really achieves. Shortening it barely
 * changes detection but steadily adds false fires: 50 -> 137/144 and 39/288,
 * 30 -> 138/144 and 51/288, 20 -> 139/144 and 56/288, which is where the
 * original Y-only rule sat.
 *
 * A complete non-hover window is required before the first trigger, and
 * after every trigger, so a stationary ring cannot repeatedly take photos. */
#define CAPTURE_HOVER_SAMPLE_RATE_HZ       120U
#define CAPTURE_HOVER_SAMPLE_PERIOD_US     \
    (1000000U / CAPTURE_HOVER_SAMPLE_RATE_HZ)
#define CAPTURE_HOVER_WINDOW_SAMPLES       30U
#define CAPTURE_HOVER_MAX_Y_RAW            773
#define CAPTURE_HOVER_MIN_Y_RAW            (-1821)
#define CAPTURE_HOVER_Z_MIN_RAW            (-5328)  /* -1.30 g */
#define CAPTURE_HOVER_Z_MAX_RAW            (-2869)  /* -0.70 g */
#define CAPTURE_HOVER_LATERAL_MAX_RAW      2459     /*  0.60 g */
#define CAPTURE_HOVER_Z_STILL_RANGE_RAW    492      /*  0.12 g peak-to-peak */
#define CAPTURE_HOVER_REARM_COOLDOWN_MS    750U

#if CAPTURE_GESTURE_SOURCE != CAPTURE_GESTURE_SOURCE_MLC && \
    CAPTURE_GESTURE_SOURCE != CAPTURE_GESTURE_SOURCE_THRESHOLD
#error "CAPTURE_GESTURE_SOURCE must select MLC or threshold"
#endif

#define EVENT_IMU_CAPTURE_GESTURE (1U << 0)

#endif
```
